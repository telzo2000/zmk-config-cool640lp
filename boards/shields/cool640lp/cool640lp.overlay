/ {
    kscan0: kscan0 {
        compatible = "zmk,kscan-gpio-matrix";
        diode-direction = "col2row";
        wakeup-source;

        col-gpios
            = <&gpio1 7  GPIO_ACTIVE_HIGH>
            , <&gpio1 7  GPIO_ACTIVE_HIGH>
            , <&gpio1 7  GPIO_ACTIVE_HIGH>
            , <&gpio1 7  GPIO_ACTIVE_HIGH>
            , <&gpio1 7  GPIO_ACTIVE_HIGH>
            , <&gpio1 7  GPIO_ACTIVE_HIGH>
            , <&gpio1 7  GPIO_ACTIVE_HIGH>
            , <&gpio1 7  GPIO_ACTIVE_HIGH>
            , <&gpio1 7  GPIO_ACTIVE_HIGH>
            , <&gpio1 7  GPIO_ACTIVE_HIGH>
            ;

        row-gpios
            = <&gpio1 7  (GPIO_ACTIVE_HIGH | GPIO_PULL_DOWN)>
            , <&gpio1 7  (GPIO_ACTIVE_HIGH | GPIO_PULL_DOWN)>
            , <&gpio1 7  (GPIO_ACTIVE_HIGH | GPIO_PULL_DOWN)>
            , <&gpio1 7  (GPIO_ACTIVE_HIGH | GPIO_PULL_DOWN)> 
            ;
    };
};